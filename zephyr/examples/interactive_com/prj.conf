## CMakeLists.txt
```
# Copyright (c) 2021 Bobby Noelte.
# SPDX-License-Identifier: Apache-2.0

cmake_minimum_required(VERSION 3.13.1)

# Get base directory.
# Assumption: this file is within the zephyr/samples/basic subdir of the thingset library.
get_filename_component(THINGSET_BASE "${CMAKE_CURRENT_SOURCE_DIR}/../../.." ABSOLUTE)
message(STATUS "THINGSET_BASE: ${THINGSET_BASE}")

# Search for Zepyhr installed side by side to thingset device library.
# This is a fallback in case ZEPHYR_BASE is not given.
set(zephyr_base $ENV{ZEPHYR_BASE})
get_filename_component(MODULES_BASE "${THINGSET_BASE}/.." ABSOLUTE)
FILE(GLOB modules LIST_DIRECTORIES true "${MODULES_BASE}/*")
foreach(module ${modules})
    set(full_path ${module}/Kconfig.zephyr)
    if(EXISTS ${full_path})
        set(zephyr_base "${module}")
        break()
    endif()
endforeach()
message(STATUS "ZEPHYR_BASE: ${zephyr_base}")

# Prepare native posix example on host
set(BOARD "native_posix")
set(ZEPHYR_TOOLCHAIN_VARIANT "host")

set(ZEPHYR_MODULES ${THINGSET_BASE})

find_package(Zephyr REQUIRED HINTS ${zephyr_base})
project(thingset_example_interactive_com)

target_sources(app PRIVATE
    src/main.c
    # test data & support
    ${THINGSET_BASE}/test/test_support.c
    ${THINGSET_BASE}/test/test_data.c
)
```

## sample.yaml
```
sample:
  name: ThingSet Interactive Example
```

## prj.conf
```kconfig
# SPDX-License-Identifier: Apache-2.0

CONFIG_THINGSET=y

# Enable all contexts for testing
CONFIG_THINGSET_CORE=y
CONFIG_THINGSET_COM=y
CONFIG_THINGSET_LOCAL_COUNT=3
CONFIG_THINGSET_PORT_COUNT=5

# Enable unit testing
CONFIG_THINGSET_UNIT_TEST=n
CONFIG_ZTEST=n
CONFIG_COVERAGE=n

# Activate assertions during testing
CONFIG_ASSERT=n

# enable all optional features to increase test coverage
CONFIG_THINGSET_64BIT_TYPES_SUPPORT=y
CONFIG_THINGSET_DECFRAC_TYPE_SUPPORT=y
CONFIG_THINGSET_BYTE_STRING_TYPE_SUPPORT=y

CONFIG_LOG=n
#CONFIG_LOG_BACKEND_NATIVE_POSIX=y
#CONFIG_THINGSET_LOG_LEVEL_DBG=y

# enable loopback port for testing
CONFIG_THINGSET_PORT_LOOPBACK_SIMPLE=y

# enable testing of applications
CONFIG_THINGSET_APPS=y

# enable shell application on UART0
CONFIG_UART_NATIVE_POSIX=y
CONFIG_NATIVE_UART_0_ON_OWN_PTY=y
CONFIG_SHELL=y
CONFIG_SHELL_BACKEND_DUMMY=y
CONFIG_SHELL_BACKEND_SERIAL=y
CONFIG_THINGSET_SHELL=y
CONFIG_THINGSET_SHELL_NAME="shell"
CONFIG_THINGSET_SHELL_LOCID=1
CONFIG_THINGSET_SHELL_PORTID=2
```

## src/main.c
```c
/*
 * Copyright (c) 2022 Bobby Noelte
 * SPDX-License-Identifier: Apache-2.0
 */

#include "../../../../test/test.h"

void main(void)
{
    (void)thingset_init(TEST_CORE_LOCID);
    (void)thingset_init(TEST_INSTANCE_LOCID);
    (void)thingset_init(TEST_NEIGHBOUR_LOCID);
    thingset_authorisation_set(TEST_CORE_LOCID, TS_ANY_RW);
    thingset_authorisation_set(TEST_INSTANCE_LOCID, TS_ANY_RW);
    thingset_authorisation_set(TEST_NEIGHBOUR_LOCID, TS_ANY_RW);
}
```
