## zephyr/Kconfig.thingset
```kconfig
# Copyright (c) 2021 Bobby Noelte
# SPDX-License-Identifier: Apache-2.0

config THINGSET
        bool "ThingSet Device Library"
        help
          This option enables the ThingSet Device Library (TS).

if THINGSET

config THINGSET_ZEPHYR
        bool
        default y
        select NET_BUF
        help
          ThingSet on Zephyr.

config THINGSET_LOG
        bool
        depends on LOG
        default y
        help
          ThingSet logging support - by default follows Zephyr LOG configuration.

config THINGSET_UNIT_TEST
        bool "Enable unit testing support"
        select ZTEST
        default n
        help
          ThingSet unit test support.

config THINGSET_ASSERT
        bool "Enable assertions"
        depends on ASSERT
        default y
        help
          ThingSet assertions - by default follows Zephyr ASSERT configuration.

config THINGSET_NUM_JSON_TOKENS
        int "Maximum number of expected JSON tokens."
        default 50
        help
          The maximum number of expected JSON tokens (i.e. arrays, map keys, values, primitives, etc.).
          Thingset throws an error if the maximum number of tokens is reached in a request or response.

config THINGSET_VERBOSE_STATUS_MESSAGES
        bool "Enable verbose status messages."
        default y
        help
          If verbose status messages are switched on, a response in text-based mode
          contains not only the status code, but also a message.

config THINGSET_64BIT_TYPES_SUPPORT
        bool "Enable support for 64 bit variable types."
        default n
        help
          Switch on support for 64 bit variable types (uint64_t, int64_t, double).
          This should be disabled for most 8-bit microcontrollers to increase performance.

config THINGSET_DECFRAC_TYPE_SUPPORT
        bool "Enable support for decimal fraction variable type."
        default n
        help
          Switch on support for CBOR decimal fraction data type which stores a decimal mantissa
          and a constant decimal exponent. This allows to use e.g. millivolts internally instead
          of floating point numbers, while still communicating the SI base unit (volts).

config THINGSET_BYTE_STRING_TYPE_SUPPORT
        bool "Enable support for byte string variable type."
        default n
        help
          Switch on support for CBOR byte strings, which can store any sort of binary data and
          can be used e.g. for firmware upgrades. Byte strings are not supported by JSON.

config THINGSET_LOCAL_COUNT
        int "Number of local context objects databases."
        default 1
        help
          Configure the total number of local contexts' object databases that a device has.

config THINGSET_COM_BUF_COUNT
        int "Number of communication buffers in the ThingSet buffer pool."
        default 16
        help
          Number of communication buffers in ThingSet device's buffer pool.

config THINGSET_COM_BUF_DATA_SIZE
        int "Data block size for ThingSet communication buffers."
        default 1024
        help
          Data block size for all ThingSet communication buffers. Buffers are allocated from this
          block.

config THINGSET_CPP_LEGACY
        bool "Enable legacy C++ interface."
        default y
        help
          This option enables the legacy C++ interface of the
          ThingSet protocol library. Enable if your C++ code uses
          DataNode or ArrayInfo instead of ThingSetDataNode or ThingSetArrayInfo.

module = THINGSET
module-str = thingset
source "subsys/logging/Kconfig.template.log_config"

rsource "Kconfig.thingset_core"
rsource "Kconfig.thingset_com"
rsource "Kconfig.thingset_apps"

endif
```

## zephyr/Kconfig.thingset_apps
```kconfig
# Copyright (c) 2021 Bobby Noelte
# SPDX-License-Identifier: Apache-2.0

config THINGSET_APPS
        bool "ThingSet Applications"
        help
          This option enables the ThingSet applications.

if THINGSET_APPS

rsource "apps/shell/Kconfig"

endif # THINGSET_APPS
```

## zephyr/Kconfig.thingset_com
```kconfig
# Copyright (c) 2021 Bobby Noelte
# SPDX-License-Identifier: Apache-2.0

config THINGSET_COM
        bool "ThingSet Communication Support"
        select POSIX_API if !ARCH_POSIX
        help
          This option enables the ThingSet communication support.

if THINGSET_COM

config THINGSET_REMOTE_COUNT
        int "Number of remote context objects databases."
        default 4
        help
          Configure the total number of remote contexts' object databases that a device has.

config THINGSET_REMOTE_OBJECT_COUNT
        int "Number of remote objects that a device may handle."
        default 16
        help
          Configure the total number of remote objects that a device may handle.

config THINGSET_PORT_COUNT
        int "Number of ThingSet ports of a device"
        default 1
        help
          Configure the number of ThingSet ports of a device.

config THINGSET_PORT_LOOPBACK_SIMPLE
        bool "Enable simmple loopback ThingSet communication port"
        default n
        depends on THINGSET_PORT_COUNT > 0
        help
          This option enables the simmple loopback ThingSet communication port.

endif # THINGSET_COM
```

## zephyr/Kconfig.thingset_core
```kconfig
# Copyright (c) 2021 Bobby Noelte
# SPDX-License-Identifier: Apache-2.0

config THINGSET_CORE
        bool "ThingSet Core Support"
        help
          This option enables the ThingSet core support.

if THINGSET_CORE

endif # THINGSET_CORE
```

## zephyr/apps/shell/Kconfig
```kconfig
# Copyright (c) 2022 Bobby Noelte
# SPDX-License-Identifier: Apache-2.0

config THINGSET_SHELL
        bool "ThingSet Shell Application"
        depends on SHELL
        depends on THINGSET_COM
        help
          This option enables the ThingSet shell application for Zephyr.

if THINGSET_SHELL

config THINGSET_SHELL_NAME
        string "Shell Application name"
        help
          The name the shell application shall use at the local context.

config THINGSET_SHELL_LOCID
        int "Shell Application local context ID"
        help
          The local context the shell applicationm shall be attached to.

config THINGSET_SHELL_PORTID
        int "Shell Application port ID"
        help
          The ID of the port the shell shall communicate to the local context.

config THINGSET_SHELL_MEM_SIZE
        int "Dynamic memory the ThingSet shell may use"
        default 32
        help
          The total size of memory the ThingSet shell may allocate. Used e.g for argument array.

endif # THINGSET_SHELL_ZEPHYR
```

## zephyr/examples/basic/Kconfig
```kconfig
# Copyright (c) 2022 Bobby Noelte.
# SPDX-License-Identifier: Apache-2.0

mainmenu "ThingSet for Zepyhr - examples/basic configuration"

source "Kconfig.zephyr"
```
